## apps/conode/Kconfig
```kconfig
#
# For a description of the syntax of this configuration file,
# see the file kconfig-language.txt in the NuttX tools repository.
#

config TESTLAB_CONODE
	tristate "conode: CANopen network node (Lely)"
	default n
	depends on NET_CAN && CANUTILS_LELYCANOPEN
	depends on CANUTILS_LELYCANOPEN_CSDO && CANUTILS_LELYCANOPEN_MASTER
	depends on CANUTILS_LELYCANOPEN_RPDO && CANUTILS_LELYCANOPEN_TPDO
	depends on CANUTILS_LELYCANOPEN_SYNC
	select NETUTILS_NETLIB
	---help---
		CANopen node on SocketCAN built on Lely CANopen.  Node-ID and
		role come from the command line: a master boots a list of
		slaves (SDO, NMT start), consumes their heartbeats and produces
		SYNC; every node sends a counter in TPDO1 on each SYNC and
		checks the counters it receives from its peers.

if TESTLAB_CONODE

config TESTLAB_CONODE_PROGNAME
	string "Program name"
	default "conode"

config TESTLAB_CONODE_PRIORITY
	int "conode task priority"
	default 100

config TESTLAB_CONODE_STACKSIZE
	int "conode stack size"
	default 8192

endif
```

## apps/fstl/Kconfig
```kconfig
#
# For a description of the syntax of this configuration file,
# see the file kconfig-language.txt in the NuttX tools repository.
#

config TESTLAB_FSTL
	tristate "fstl: file system test tool"
	default n
	depends on !DISABLE_MOUNTPOINT && !DISABLE_PTHREAD
	---help---
		File system checks that do not depend on one file system:
		pattern data I/O, positioned I/O, truncation, directory
		listing, stat fields, error numbers, concurrent writers,
		mount and program execution.  Each run prints one PASS/FAIL
		verdict line.

if TESTLAB_FSTL

config TESTLAB_FSTL_PROGNAME
	string "Program name"
	default "fstl"

config TESTLAB_FSTL_PRIORITY
	int "fstl task priority"
	default 100

config TESTLAB_FSTL_STACKSIZE
	int "fstl stack size"
	default DEFAULT_TASK_STACKSIZE

config TESTLAB_FSTL_BUFSIZE
	int "fstl default I/O buffer size"
	default 4096

endif
```

## apps/tlstl/Kconfig
```kconfig
#
# For a description of the syntax of this configuration file,
# see the file kconfig-language.txt in the NuttX tools repository.
#

config TESTLAB_TLSTL
	tristate "tlstl: TLS interoperability test tool"
	default n
	depends on NET_TCP && CRYPTO_MBEDTLS && MBEDTLS_SSL_TLS_C
	depends on MBEDTLS_X509_CRT_PARSE_C && MBEDTLS_CTR_DRBG_C
	depends on MBEDTLS_ENTROPY_C && MBEDTLS_PEM_PARSE_C
	---help---
		Mbed TLS client/server that echoes a deterministic data
		pattern over TLS, reports how the peer ended the stream and
		prints a PASS/FAIL verdict line.

if TESTLAB_TLSTL

config TESTLAB_TLSTL_PROGNAME
	string "Program name"
	default "tlstl"

config TESTLAB_TLSTL_PRIORITY
	int "tlstl task priority"
	default 100

config TESTLAB_TLSTL_STACKSIZE
	int "tlstl stack size (main task and session threads)"
	default 16384

config TESTLAB_TLSTL_BUFSIZE
	int "tlstl I/O buffer size per session"
	default 4096

endif
```
